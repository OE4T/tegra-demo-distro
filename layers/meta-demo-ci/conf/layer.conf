## layers/meta-demo-ci/conf/layer.conf
```bitbake
BBPATH =. "${LAYERDIR}:"
BBFILES += "${LAYERDIR}/recipes-*/*/*.bb ${LAYERDIR}/recipes-*/*/*.bbappend"

BBFILE_COLLECTIONS += "tegrademo-ci"
BBFILE_PATTERN_tegrademo-ci = "^${LAYERDIR}/"
BBFILE_PATTERN_IGNORE_EMPTY_tegrademo-ci = "1"
BBFILE_PRIORITY_tegrademo-ci = "40"

LAYERVERSION_tegrademo-ci = "1"
LAYERDEPENDS_tegrademo-ci = "core"
LAYERSERIES_COMPAT_tegrademo-ci = "honister"
```

## layers/meta-tegra-support/conf/layer.conf
```bitbake
BBPATH =. "${LAYERDIR}:"
BBFILES += "${LAYERDIR}/recipes-*/*/*.bb ${LAYERDIR}/recipes-*/*/*.bbappend"

BBFILE_COLLECTIONS += "tegrasupport"
BBFILE_PATTERN_tegrasupport = "^${LAYERDIR}/"
BBFILE_PRIORITY_tegrasupport = "40"

LAYERVERSION_tegrasupport = "4"
LAYERDEPENDS_tegrasupport = "core tegra"
LAYERSERIES_COMPAT_tegrasupport = "kirkstone langdale"
```

## layers/meta-tegrademo/conf/distro/include/tegrademo.inc
```bitbake
DISTRO = "tegrademo"
DISTRO_NAME = "OE4Tegra Demonstration Distro"
DISTRO_VERSION_BASE = "6.1"
DISTRO_VERSION = "${DISTRO_VERSION_BASE}+snapshot-${METADATA_REVISION}"
DISTRO_CODENAME = "master"
SDK_VENDOR = "-tdsdk"
SDK_VERSION = "${@d.getVar('DISTRO_VERSION').replace('snapshot-${METADATA_REVISION}', 'snapshot')}"
SDK_VERSION[vardepvalue] = "${SDK_VERSION}"

MAINTAINER = "OE4Tegra team <oe4tegra@madison.systems>"

TARGET_VENDOR = "-oe4t"

# New ${DISTRO}-<version> setting for sanity checks.
# Increment version number (and the corresponding
# setting int the template bblayers.conf.sample file)
# each time the layer settings are changed.
REQUIRED_TD_BBLAYERS_CONF_VERSION = "${DISTRO}-7"

LOCALCONF_VERSION = "2"

TD_DEFAULT_DISTRO_FEATURES = "pam virtualization"
DISTRO_FEATURES ?= "${TD_DEFAULT_DISTRO_FEATURES}"

# Keeping the NVIDIA downstream kernel as the
# default, until linux-yocto support is
# available for both Orin and Thor targets.
TEGRA_DEFAULT_KERNEL ?= "linux-noble-nvidia-tegra"
PREFERRED_PROVIDER_virtual/kernel:tegra = "${TEGRA_DEFAULT_KERNEL}"
PREFERRED_VERSION_linux-yocto ?= "6.18%"
PREFERRED_VERSION_linux-yocto-rt ?= "6.18%"

SDK_NAME = "${DISTRO}-${TCLIBC}-${SDKMACHINE}-${IMAGE_BASENAME}-${TUNE_PKGARCH}-${MACHINE}"
SDKPATHINSTALL = "/opt/${DISTRO}/${SDK_VERSION}"

PACKAGE_CLASSES ?= "package_rpm"

SANITY_TESTED_DISTROS ?= " \
            ubuntu-20.04 \n \
            ubuntu-22.04 \n \
            ubuntu-24.04 \n \
            "

# Most NVIDIA-supplied services expect systemd
INIT_MANAGER = "systemd"

LICENSE_FLAGS_ACCEPTED += "commercial_faad2 commercial_x264"

USE_REDUNDANT_FLASH_LAYOUT_DEFAULT ?= "1"

# for docker-registry-config
DOCKER_OCI_RUNTIMES ?= '{"nvidia":{"args":[],"path":"nvidia-container-runtime"}}'
```

## layers/meta-tegrademo/conf/distro/tegrademo-mender.conf
```bitbake
include tegrademo.conf
REQUIRED_TD_BBLAYERS_CONF_VERSION = "${DISTRO}-8"

DISTRO = "tegrademo-mender"
DISTRO_NAME = "OE4Tegra Demonstration Distro with Mender"

# The distro version doesn't include DATE to avoid basehash changes in do_image_mender
DISTRO_VERSION = "${DISTRO_VERSION_BASE}+snapshot"

### Additions for mender ###

INHERIT += "mender-full distro_layer_buildinfo"
INHERIT:append:tegra = " tegra-mender-setup mender-workarounds"
DISTRO_LAYER = "meta-tegrademo"

BUILDNAME ?= "${@d.getVar('DISTRO_VERSION').replace('+snapshot','')}${DISTRO_LAYER_BUILDTAG}"
BUILDNAME[vardepvalue] = "${DISTRO_VERSION}"

MENDER_ARTIFACT_NAME ?= "${IMAGE_BASENAME}_${BUILDNAME}"

IMAGE_FSTYPES:tegra = "tegraflash mender dataimg"
IMAGE_FSTYPES:pn-tegra-minimal-initramfs:tegra = "${INITRAMFS_FSTYPES}"
IMAGE_FSTYPES:pn-tegra-initrd-flash-initramfs:tegra = "${TEGRA_INITRD_FLASH_INITRAMFS_FSTYPES}"
IMAGE_FEATURES:append = " read-only-rootfs"
IMGCLASSES:append = " rootfs-postcommands-overrides"

# Make more room for the data partition, so we can use it to hold
# docker container filesystems.
MENDER_DATA_PART_SIZE_MB_DEFAULT:tegra = "3072"

# Account for the additional 950MB we used to reserve via a separate
# variable, on top of the default 1024MB.  On Nano-2gb, it was 5046MB
# to cover the addition of the swap partition.
TEGRA_MENDER_RESERVED_SPACE_MB = "1974"
TEGRA_MENDER_RESERVED_SPACE_MB:jetson-nano-2gb-devkit = "6070"

# Mender machines need to run checks after an update
SYSTEMD_DEFAULT_TARGET = "finished-booting.target"

# Use cboot by default on TX2 to avoid uboot slot alignment issues
PREFERRED_PROVIDER_virtual/bootloader:tegra186 = "cboot-t18x"

# Use u-boot by default on the TX2 COT when using the FIT image
PREFERRED_PROVIDER_virtual/bootloader:jetson-tx2-devkit-cot = "u-boot-tegra"
```

## layers/meta-tegrademo/conf/layer.conf
```bitbake
BBPATH =. "${LAYERDIR}:${LAYERDIR}/dynamic-layers/meta-swupdate:"
BBFILES += "${LAYERDIR}/recipes-*/*/*.bb ${LAYERDIR}/recipes-*/*/*.bbappend"
BBFILES_DYNAMIC += "swupdate:${LAYERDIR}/dynamic-layers/meta-swupdate/recipes-*/*/*.bb \
                    swupdate:${LAYERDIR}/dynamic-layers/meta-swupdate/recipes-*/*/*.bbappend"

BBFILE_COLLECTIONS += "tegrademo"
BBFILE_PATTERN_tegrademo = "^${LAYERDIR}/"
BBFILE_PRIORITY_tegrademo = "50"

LAYERVERSION_tegrademo = "4"
LAYERSERIES_COMPAT_tegrademo = "walnascar"

# This is used by the tegra-distro-sanity bbclass
# to identify the distro layer directory during
# bblayers checks.
TD_DISTRO_LAYERDIR = "${LAYERDIR}"
```

## layers/meta-tegrademo/conf/machine/jetson-nano-devkit-emmc-cot.conf
```bitbake
MACHINEOVERRIDES = "jetson-nano-devkit-emmc:cot:${MACHINE}"
require conf/machine/jetson-nano-devkit-emmc.conf
PACKAGE_EXTRA_ARCHS:append = " jetson-nano-devkit-emmc"
KERNEL_CLASSES += "tegra-kernel-fitimage"
KERNEL_IMAGETYPE = "fitImage"
TEGRA_ESSENTIAL_EXTRA_RDEPENDS:remove = "kernel-image u-boot-extlinux"
TEGRA_ESSENTIAL_EXTRA_RDEPENDS:append = " tegra-fitimage"
MACHINE_ESSENTIAL_EXTRA_RDEPENDS:remove = "kernel-image kernel-devicetree"
INITRAMFS_IMAGE_BUNDLE = "1"
UBOOT_EXTLINUX = "0"
UBOOT_ENTRYPOINT = "0x80080000"
UBOOT_LOADADDRESS = "0x80080000"
UBOOT_DTB_LOADADDRESS = "0x80000000"
UBOOT_DTBO_LOADADDRESS = "0x80000000"
UBOOT_RD_LOADADDRESS = "0x82a00000"
UBOOT_RD_ENTRYPOINT = "0x82a00000"
FIT_INCLUDE_DTBS = "0"
FIT_KERNEL_COMP_ALG = "none"
```

## layers/meta-tegrademo/conf/machine/jetson-nano-qspi-sd-cot.conf
```bitbake
MACHINEOVERRIDES = "jetson-nano-qspi-sd:cot:${MACHINE}"
require conf/machine/jetson-nano-qspi-sd.conf
PACKAGE_EXTRA_ARCHS_append = " jetson-nano-qspi-sd"
KERNEL_CLASSES += "kernel-fitimage"
KERNEL_IMAGETYPES += "fitImage"
INITRAMFS_IMAGE_BUNDLE = "1"
UBOOT_EXTLINUX = "0"
UBOOT_ENTRYPOINT = "0x80080000"
UBOOT_LOADADDRESS = "0x80080000"
UBOOT_DTB_LOADADDRESS = "0x80000000"
UBOOT_DTBO_LOADADDRESS = "0x80000000"
UBOOT_RD_LOADADDRESS = "0x82a00000"
UBOOT_RD_ENTRYPOINT = "0x82a00000"
```

## layers/meta-tegrademo/conf/machine/jetson-tx2-devkit-cot.conf
```bitbake
MACHINEOVERRIDES = "jetson-tx2-devkit:cot:${MACHINE}"
require conf/machine/jetson-tx2-devkit.conf
PACKAGE_EXTRA_ARCHS_append = " jetson-tx2-devkit"
KERNEL_CLASSES += "tegra-kernel-fitimage"
KERNEL_IMAGETYPE = "fitImage"
TEGRA_ESSENTIAL_EXTRA_RDEPENDS_remove = "u-boot-extlinux"
TEGRA_ESSENTIAL_EXTRA_RDEPENDS_append = " tegra-fitimage"
PREFERRED_PROVIDER_virtual/bootloader = "u-boot-tegra"
INITRAMFS_IMAGE_BUNDLE = "1"
UBOOT_EXTLINUX = "0"
UBOOT_ENTRYPOINT = "0x80080000"
UBOOT_LOADADDRESS = "0x80080000"
UBOOT_DTB_LOADADDRESS = "0x80000000"
UBOOT_DTBO_LOADADDRESS = "0x80000000"
UBOOT_RD_LOADADDRESS = "0x82a00000"
UBOOT_RD_ENTRYPOINT = "0x82a00000"
FIT_INCLUDE_DTBS = "0"
FIT_KERNEL_COMP_ALG = "none"
```
