#include "tegra234-p3768-0000+p3767-0005-nv-super.dts"

/* adds compatible string for oe4t, for demonstration purposes */
/ {
	compatible = "oe4t,p3768-0000+p3767-0005+tegrademo", "nvidia,p3768-0000+p3767-0005-super", "nvidia,p3767-0005", "nvidia,tegra234";
};
