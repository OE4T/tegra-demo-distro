#include "tegra264-p4071-0000+p3834-0000-nv.dts"

/* adds compatible string for oe4t, for demonstration purposes */
/ {
	compatible = "oe4t,p4071-0000+p3834-0000+tegrademo", "nvidia,p4071-0000+p3834-0000", "nvidia,p3834-0000", "nvidia,tegra264";
};
